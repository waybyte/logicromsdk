/* Memory information for MT2503 and MT2621 */
TARGET_ROM_ORIGIN = 0x102E0040;
TARGET_ROM_LEN = 0x00040000;
TARGET_RAM_ORIGIN = 0xF03D3800;
TARGET_RAM_LEN = 0x00017800;

INCLUDE linkerscript_common.lds
